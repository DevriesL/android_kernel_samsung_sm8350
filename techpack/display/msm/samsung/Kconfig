## techpack/display/msm/samsung/Kconfig
```kconfig
config SAMSUNG_DEBUG_DISPLAY
	bool "Add Samsung Debugging code"
	default n

config DISPLAY_SAMSUNG
	bool "mdss config for samsung product"
	default n
	---help---
	Mdss config signature for samsung product

#
#	PANEL UNIQUE FEATURE
#
config DUAL_PANEL
	depends on DISPLAY_SAMSUNG
	bool "dual paneloperation"
	default n
	---help---
	dual panel operation support

config PARTIAL_UPDATE
	depends on DISPLAY_SAMSUNG
	bool "partial update operation"
	default n
	---help---
	partial update operation support

config CABC_FUNCTION
	depends on DISPLAY_SAMSUNG
	bool "DDI cabc operation"
	default n
	---help---
	DDI cabc operation support

config SUPPORT_POC_FLASH
	depends on DISPLAY_SAMSUNG
	bool "SUPPORT POC FLASH"
	default n
	---help---
	SUPPORT_POC_FLASH FOR DREAM2 ONLY

config HYBRID_DC_DIMMING
	depends on DISPLAY_SAMSUNG
	bool "FORCED HYBRID DC DIMMING"
	default n
	---help---
	Forced dc dimming mode by hijack panel
	gamma and mdnie color controller.

config MDNIE_TRUE_COLOR
	depends on DISPLAY_SAMSUNG
	bool "MDNIE TRUE COLOR MODE"
	default n
	---help---
	Disable mDNIe unreal color processing to 
	display true color in UI.
```
